## configs/atngw100_irc_defconfig
```kconfig
BR2_avr32=y
BR2_KERNEL_HEADERS_3_9=y
BR2_TOOLCHAIN_BUILDROOT_WCHAR=y
BR2_PTHREAD_DEBUG=y
BR2_PACKAGE_HOST_GDB=y
BR2_ROOTFS_OVERLAY="board/atmel/atngw100/rootfs-overlay"
BR2_LINUX_KERNEL=y
BR2_LINUX_KERNEL_CUSTOM_VERSION=y
BR2_LINUX_KERNEL_CUSTOM_VERSION_VALUE="3.9.11"
BR2_LINUX_KERNEL_DEFCONFIG="atngw100"
BR2_LINUX_KERNEL_INSTALL_TARGET=y
BR2_PACKAGE_DHRYSTONE=y
BR2_PACKAGE_GDB=y
BR2_PACKAGE_OPENSSL=y
BR2_PACKAGE_NCURSES=y
BR2_PACKAGE_NGIRCD=y
BR2_PACKAGE_NTP=y
BR2_PACKAGE_NTP_NTPDATE=y
BR2_TARGET_ROOTFS_JFFS2=y
BR2_TARGET_ROOTFS_JFFS2_NOCLEANMARKER=y
BR2_TARGET_UBOOT=y
BR2_TARGET_UBOOT_BOARDNAME="atngw100"
BR2_TARGET_UBOOT_CUSTOM_VERSION=y
BR2_TARGET_UBOOT_CUSTOM_VERSION_VALUE="2010.09"
 
```
